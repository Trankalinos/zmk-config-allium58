## boards/shields/allium58/Kconfig.shield
```kconfig
# No whitespace after the comma or in the keyboard name!
config SHIELD_ALLIUM58_DONGLE
    def_bool $(shields_list_contains,allium58_dongle)
```

## boards/shields/my_keyboard/Kconfig.shield
```kconfig
# No whitespace after the comma or in your part name!
config SHIELD_MY_KEYBOARD_LEFT
    def_bool $(shields_list_contains,lily58_left)

# No whitespace after the comma or in your part name!
config SHIELD_MY_KEYBOARD_RIGHT
    def_bool $(shields_list_contains,lily58_right)
```
